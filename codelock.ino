/*
 * oled codelock
 *
 * Created: 10/01/2021
 *  Author: moty22.co.uk
 */ 
#include <Wire.h>
#include <EEPROM.h>

unsigned char addr=0x3C;  //0x78

// standard ascii 5x7 font 
//  0x3E, 0x51, 0x49, 0x45, 0x3E,  //crossed 0
static const unsigned char  font[] = {
  0x00, 0x00, 0x00, 0x00, 0x00, 
  0x00, 0x00, 0x5F, 0x00, 0x00, 
  0x00, 0x07, 0x00, 0x07, 0x00, 
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  0x00, 0x08, 0x36, 0x41, 0x00, 
};
unsigned char key, mem[4], num[4], ir=0;
bool pMode=false;

void setup() {
    pinMode(7, OUTPUT);
    pinMode(8, OUTPUT);
    pinMode(9, OUTPUT);
    pinMode(10, OUTPUT);
    pinMode(11, OUTPUT);  //ready LED
    pinMode(2, INPUT_PULLUP); 
    pinMode(3, INPUT_PULLUP);
    pinMode(4, INPUT_PULLUP);
    pinMode(5, INPUT_PULLUP);
    pinMode(6, INPUT_PULLUP);   
    
    Wire.begin();        // init i2c bus
    Wire.setClock(200000);  //200khz
    oled_init();
    clrScreen();

    digitalWrite(7, LOW); 
    digitalWrite(8, LOW); 
    digitalWrite(9, LOW); 
    digitalWrite(10, LOW);

    readyL();
    for(unsigned char i=0;i<4;++i){
      num[i] = EEPROM.read(i);
    }
    for(unsigned char j=0;j<4;j++){
      drawChar2(0x5F,5,j+2); 
    }
}

void loop()
{

  if(!digitalRead(6)){
      pMode=true;
      drawChar2(0x43,1,2);  //code
      drawChar2(0x4F,1,3);
      drawChar2(0x44,1,4);
      drawChar2(0x45,1,5);
      drawChar2(32,1,6); 
      digitalWrite(11, LOW);
  }

  if(!digitalRead(5) || !digitalRead(4) || !digitalRead(3) || !digitalRead(2)){
    get_key();
    drawChar2(key+48,5,ir+2);
    mem[ir]=key;
    if(ir==3 && pMode==false){
      if (mem[0]==num[0] && mem[1]==num[1] && mem[2]==num[2] && mem[3]==num[3]){
          digitalWrite(7,HIGH); 
          delay(2000);
          digitalWrite(7,LOW);
      }
    }
    if(ir==3 && pMode==true){
      for(unsigned char j=0;j<4;j++){
        EEPROM.write(j, mem[j]);
      }
      num[0]=mem[0];
      num[1]=mem[1];
      num[2]=mem[2];
      num[3]=mem[3];
      pMode=false;
      readyL();
    }
    ir++;
    if(ir==4){
        ir=0;
        for(unsigned char j=0;j<4;j++){
          drawChar2(0x5F,5,j+2); 
        }
    }
    while(!digitalRead(5) || !digitalRead(4) || !digitalRead(3) || !digitalRead(2)){}
    delay(100);
  }

}

void readyL(){
  drawChar2(0x52,1,2); //ready label
  drawChar2(0x45,1,3);
  drawChar2(0x41,1,4);
  drawChar2(0x44,1,5);
  drawChar2(0x59,1,6);
  digitalWrite(11, HIGH);
}

void get_key(){
  digitalWrite(8, LOW); 
  digitalWrite(9, HIGH); 
  digitalWrite(10, HIGH);
  if(!digitalRead(5)){key=1;}
  if(!digitalRead(4)){key=4;}
  if(!digitalRead(3)){key=7;}

  digitalWrite(9, LOW); 
  digitalWrite(8, HIGH); 
  digitalWrite(10, HIGH);
  if(!digitalRead(5)){key=2;}
  if(!digitalRead(4)){key=5;}
  if(!digitalRead(3)){key=8;}
  if(!digitalRead(2)){key=0;}

  digitalWrite(10, LOW); 
  digitalWrite(9, HIGH); 
  digitalWrite(8, HIGH);
  if(!digitalRead(5)){key=3;}
  if(!digitalRead(4)){key=6;}
  if(!digitalRead(3)){key=9;}

  digitalWrite(8, LOW); 
  digitalWrite(9, LOW);
}

void clrScreen()    //fill screen with 0
{
    unsigned char y, x;

    for ( y = 0; y < 8; y++ ) {
      for (x = 0; x < 17; x++){
          command(0x21);     //col addr
          command(8 * x); //col start
          command(8 * x + 7);  //col end
          command(0x22);    //0x22
          command(y); // Page start
          command(y); // Page end
          
          Wire.beginTransmission(addr);
          Wire.write(0x40);
          for (unsigned char i = 0; i < 8; i++){
               Wire.write(0x00);          
          }
          Wire.endTransmission();         
      }
     
    }
}

void command( unsigned char comm){
    Wire.beginTransmission(addr); 
    Wire.write(0x00);    
    Wire.write(comm); // LSB
    Wire.endTransmission();       
}

void oled_init() {
    
    command(0xAE);   // DISPLAYOFF
    command(0x8D);         // CHARGEPUMP *
    command(0x14);     //0x14-pump on
    command(0x20);         // MEMORYMODE
    command(0x0);      //0x0=horizontal, 0x01=vertical, 0x02=page
    command(0xA1);        //SEGREMAP * A0/A1=top/bottom 
    command(0xC8);     //COMSCANDEC * C0/C8=left/right
    command(0xDA);         // SETCOMPINS *
    command(0x12);   //0x22=4rows, 0x12=8rows
    command(0x81);        // SETCONTRAST
    command(0x9F);     //0x8F
    //following settings are set by default
//    command(0xD5);  //SETDISPLAYCLOCKDIV 
//    command(0x80);  
//    command(0xA8);       // SETMULTIPLEX
//    command(0x3F);     //0x1F
//    command(0xD3);   // SETDISPLAYOFFSET
//    command(0x0);  
//    command(0x40); // SETSTARTLINE  
//    command(0xD9);       // SETPRECHARGE
//    command(0xF1);
//    command(0xDB);      // SETVCOMDETECT
//    command(0x40);
//    command(0xA4);     // DISPLAYALLON_RESUME
//    command(0xA6);      // NORMALDISPLAY
    command(0xAF);          //DISPLAYON

}

    //size x1 chars
void drawChar(char fig, unsigned char y, unsigned char x)
{
    
    command(0x21);     //col addr
    command(7 * x); //col start
    command(7 * x + 4);  //col end
    command(0x22);    //0x22
    command(y); // Page start
    command(y); // Page end
    
    Wire.beginTransmission(addr);
    Wire.write(0x40);
    for (unsigned char i = 0; i < 5; i++){
         Wire.write(font[5*(fig-32)+i]);          
    }
    Wire.endTransmission();
 
 }
    //size x2 chars
void drawChar2(char fig, unsigned char y, unsigned char x)
{
    unsigned char i, line, btm, top;    //
    
    command(0x20);    // vert mode
    command(0x01);

    command(0x21);     //col addr
    command(13 * x); //col start
    command(13 * x + 9);  //col end
    command(0x22);    //0x22
    command(y); // Page start
    command(y+1); // Page end
    
    Wire.beginTransmission(addr);
    Wire.write(0x40);

    for (i = 0; i < 5; i++){
        line=font[5*(fig-32)+i];  //line=font[5*(fig-32)+i];
        btm=0; top=0;
            // expend char    
        if(line & 64) {btm +=192;}
        if(line & 32) {btm +=48;}
        if(line & 16) {btm +=12;}           
        if(line & 8) {btm +=3;}
        
        if(line & 4) {top +=192;}
        if(line & 2) {top +=48;}
        if(line & 1) {top +=12;} 
               
         Wire.write(top); //top page
         Wire.write(btm);  //second page
         Wire.write(top);
         Wire.write(btm);

    }
    Wire.endTransmission();
        
    command(0x20);      // horizontal mode
    command(0x00);    
        
}
